## Kconfig
```kconfig
# SPDX-License-Identifier: GPL-2.0-only
config VIDEO_SMI2021
	tristate "Somagic SMI2021 USB video capture support"
	depends on VIDEO_DEV && I2C && SND
	select VIDEOBUF2_VMALLOC
	select VIDEO_SAA711X
	select SND_PCM
	help
	  This is a video4linux driver for Somagic SMI2021 based analog
	  video capture devices, which are sold under names such as
	  EasyCAP DC60 and EasyCAP 002.

	  These devices have no on-board flash and need a firmware to be
	  uploaded every time they are plugged in.

	  To compile this driver as a module, choose M here: the
	  module will be called smi2021.
```
